## configs/sevenux_x86_64_defconfig
```kconfig
BR2_x86_64=y
BR2_TOOLCHAIN_BUILDROOT_GLIBC=y
BR2_PACKAGE_HOST_LINUX_HEADERS_CUSTOM_6_12=y
BR2_LINUX_KERNEL=y
BR2_LINUX_KERNEL_USE_DEFCONFIG=y
BR2_LINUX_KERNEL_DEFCONFIG="x86_64"
BR2_LINUX_KERNEL_VMLINUX=y
BR2_LINUX_KERNEL_BZIMAGE=y
BR2_PACKAGE_BUSYBOX=y
# No login prompt / getty
BR2_TARGET_GENERIC_GETTY=n
BR2_ROOTFS_OVERLAY="board/sevenux/rootfs_overlay"
BR2_ROOTFS_POST_BUILD_SCRIPT="board/sevenux/post-build.sh"
BR2_PACKAGE_PYTHON3=y
BR2_TARGET_SYSLINUX=y
BR2_TARGET_SYSLINUX_ISOLINUX=y
BR2_TARGET_SYSLINUX_KERNEL_ARGS="quiet loglevel=0 vt.global_cursor_default=0"
BR2_TARGET_ROOTFS_EXT2=y
BR2_TARGET_ROOTFS_EXT2_4=y
BR2_TARGET_ROOTFS_EXT2_SIZE="256M"

# Build a bootable ISO image (BIOS/ISOLINUX) without GRUB
BR2_TARGET_ROOTFS_ISO9660=y
BR2_TARGET_ROOTFS_ISO9660_ISOLINUX=y
BR2_TARGET_ROOTFS_ISO9660_INITRD=y
BR2_TARGET_ROOTFS_ISO9660_HYBRID=y
```
